#include "stm32f10x.h"
#include "absacc.h"							//用于定位flash变量地址


#define FLASH_ADDRES  0x0801E800

#define FLASH_SLOT_SIZE 128			  		//半字数，为2倍字节数
#define FLASH_SIZE 1024
#define FLASH_SLOT_NUM (FLASH_SIZE/FLASH_SLOT_SIZE)

static const u16 storage[FLASH_SIZE] __at (FLASH_ADDRES)={
0x0000,0xFFFF,0xFFFF,0xFFFF,0xFFFF,0xFFFF,0xFFFF,0xFFFF,0xFFFF,0xFFFF,0xFFFF,0xFFFF,0xFFFF,0xFFFF,0xFFFF,0xFFFF,
0xFFFF,0xFFFF,0xFFFF,0xFFFF,0xFFFF,0xFFFF,0xFFFF,0xFFFF,0xFFFF,0xFFFF,0xFFFF,0xFFFF,0xFFFF,0xFFFF,0xFFFF,0xFFFF,
0xFFFF,0xFFFF,0xFFFF,0xFFFF,0xFFFF,0xFFFF,0xFFFF,0xFFFF,0xFFFF,0xFFFF,0xFFFF,0xFFFF,0xFFFF,0xFFFF,0xFFFF,0xFFFF,
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0xFFFF,0xFFFF,0xFFFF,0xFFFF,0xFFFF,0xFFFF,0xFFFF,0xFFFF,0xFFFF,0xFFFF,0xFFFF,0xFFFF,0xFFFF,0xFFFF,0xFFFF,0xFFFF,
};

static u16 FlashCurSlot;					//当前SLOT的第一个数索引
static u16 FlashIndex;						//当前SLOT的写入指针

//索引从0开始
u16 FlashGetData(u16 index)
{
	if(index>=FLASH_SLOT_SIZE-1)return 0;
	return storage[FlashCurSlot+index+1];
}

u16 FlashGetTimes()
{
	return storage[FlashCurSlot];
}

void FlashInit()
{  
	u16 i;
	for(i=FLASH_SLOT_SIZE;i<FLASH_SIZE;i+=FLASH_SLOT_SIZE)
	{
		if(storage[i] == 0xFFFF)
			break;
	}

	FlashCurSlot = i-FLASH_SLOT_SIZE;
}

void FlashEraseSlot()
{
	u16 times;
	times = storage[FlashCurSlot];
	if(times>=0xFFFE)
		times = 0xFFFE;
	else
		times++;

	FLASH_ClearFlag(FLASH_FLAG_BSY | FLASH_FLAG_EOP | FLASH_FLAG_PGERR | FLASH_FLAG_WRPRTERR);
	if((FlashCurSlot+FLASH_SLOT_SIZE)>=FLASH_SIZE)
	{
		FLASH_ErasePage(FLASH_ADDRES);
		FlashCurSlot = 0;	
	}
	else
	{	
		FlashCurSlot+=FLASH_SLOT_SIZE;	
	}
	FlashIndex = 1;	
	
	FLASH_ProgramHalfWord(FLASH_ADDRES+FlashCurSlot*2,times);
}

//必须连续按顺序写入，且之前要调用FlashEraseSlot
void FlashWriteData(u16 data)
{
	if(FlashIndex>=FLASH_SLOT_SIZE-1)return;
	FLASH_ClearFlag(FLASH_FLAG_BSY | FLASH_FLAG_EOP | FLASH_FLAG_PGERR | FLASH_FLAG_WRPRTERR);
	FLASH_ProgramHalfWord(FLASH_ADDRES+(FlashCurSlot+FlashIndex)*2,data);
	FlashIndex++;
}
